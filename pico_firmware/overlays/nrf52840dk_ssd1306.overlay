/*
 * Common 128x64 I2C SSD1306 module on the nRF52840 DK Arduino header.
 * This is explicit rather than automatic because the purchased OLED controller
 * and the final prototype board pinout still need to be confirmed.
 */

#include <zephyr/dt-bindings/i2c/i2c.h>

/ {
    chosen {
        zephyr,display = &pico_oled;
    };
};

&arduino_i2c {
    status = "okay";
    clock-frequency = <I2C_BITRATE_FAST>;
    zephyr,concat-buf-size = <1024>;
    zephyr,flash-buf-max-size = <1024>;

    pico_oled: ssd1306@3c {
        compatible = "solomon,ssd1306fb";
        reg = <0x3c>;
        width = <128>;
        height = <64>;
        segment-offset = <0>;
        page-offset = <0>;
        display-offset = <0>;
        multiplex-ratio = <63>;
        segment-remap;
        com-invdir;
        prechargep = <0x22>;
    };
};
